## soc/arm/nxp_imx/rt/Kconfig.defconfig.mimxrt1051
```kconfig
# i.MX RT1051

# Copyright (c) 2017, NXP
# SPDX-License-Identifier: Apache-2.0

if SOC_MIMXRT1051

config SOC
	default "mimxrt1051"

config NUM_IRQS
	default 160

config ARM_DIV
	default 1

config AHB_DIV
	default 0

config IPG_DIV
	default 3

config GPIO
	default y

endif # SOC_MIMXRT1051
```
